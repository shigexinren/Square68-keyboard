## config/west.yml
```yaml
manifest:
  remotes:
    - name: zephyrproject-rtos
      url-base: https://github.com/zephyrproject-rtos
    - name: zmkfirmware
      url-base: https://github.com/petejohanson
    # niceview相关代码
    # - name: gpeye
    #   url-base: https://github.com/GPeye
    # Additional modules containing boards/shields/custom code can be listed here as well
    # See https://docs.zephyrproject.org/3.2.0/develop/west/manifest.html#projects
    # 这里是添加dongle-display，https://github.com/englmaxi/zmk-dongle-display
    # - name: englmaxi
    #   url-base: https://github.com/englmaxi
    # - name: kawvin
    #   url-base: https://github.com/kawvin
    # - name: GarrettFaucher
    #   url-base: https://github.com/GarrettFaucher
  projects:
    - name: zmk
      remote: zmkfirmware
      revision: feat/pointers-move-scroll
      import: app/west.yml
    # niceview相关代码
    # - name: urchin-peripheral-animation
    #   remote: gpeye
    #   revision: main
    # 这里是添加dongle-display，https://github.com/englmaxi/zmk-dongle-display
    # - name: zmk-dongle-display
    #   remote: englmaxi
    #   revision: main
    # - name: zmk-dongle-display-091-drum
    #   remote: kawvin
    #   revision: main
    # - name: zmk-dongle-display-091-oled
    #   remote: GarrettFaucher
    #   revision: main
    
    - name: nanopb
      revision: 65cbefb4695bc7af1cb733ced99618afb3586b20
      path: modules/lib/nanopb
      remote: zephyrproject-rtos
    - name: zmk-studio-messages
      revision: a79267a9661241a6603b6da3d2b3f71e8023a9d9
      path: modules/msgs/zmk-studio-messages
      remote: zmkfirmware
  
  self:
    path: config
```
